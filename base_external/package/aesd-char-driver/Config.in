## base_external/package/aesd-char-driver/Config.in
```kconfig
config BR2_PACKAGE_AESDCHARDRIVER
	bool "aesd-char-driver"
	help
	  Includes the writer executable, finder.sh and tester.sh in the kernel image.
	  Used to understand buildroot external trees and package builds.
```

## base_external/package/ldd/Config.in
```kconfig
config BR2_PACKAGE_LDD
	bool "ldd"
	help
	  Includes cross-compiled kernel modules misc-modules and scull
```
